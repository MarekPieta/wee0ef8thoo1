## CMakeLists.txt
```
# Copyright (c) 2021 Nordic Semiconductor ASA
# SPDX-License-Identifier: Apache-2.0

cmake_minimum_required(VERSION 3.20.0)
find_package(Zephyr REQUIRED HINTS $ENV{ZEPHYR_BASE})
project(wee0ef8thoo1)

FILE(GLOB app_sources src/*.c)
target_sources(app PRIVATE ${app_sources})
```

## prj.conf
```kconfig
CONFIG_USB=y
CONFIG_USB_DEVICE_STACK=y
CONFIG_USB_DEVICE_PRODUCT="Zephyr USB reboot sample"
CONFIG_LOG=y

CONFIG_ASSERT=y
CONFIG_ASSERT_NO_COND_INFO=y
CONFIG_ASSERT_NO_MSG_INFO=y
CONFIG_HW_STACK_PROTECTION=y

CONFIG_REBOOT=y

CONFIG_USB_NRFX_ATTACHED_EVENT_DELAY=1

CONFIG_GPIO=y

CONFIG_CONSOLE=n
CONFIG_UART_CONSOLE=n
CONFIG_SERIAL=n
CONFIG_ENTROPY_GENERATOR=n
CONFIG_LOG=n
CONFIG_RESET_ON_FATAL_ERROR=n
CONFIG_CLOCK_CONTROL_NRF_K32SRC_RC=y
CONFIG_CLOCK_CONTROL_NRF_K32SRC_RC_CALIBRATION=n

CONFIG_DEBUG_OPTIMIZATIONS=y
```

## src/main.c
```c
/*
 * Copyright (c) 2021 Nordic Semiconductor ASA
 *
 * SPDX-License-Identifier: Apache-2.0
 */

#include <zephyr.h>
#include <usb/usb_device.h>
#include <power/reboot.h>
#include <drivers/gpio.h>

#include <logging/log.h>
LOG_MODULE_REGISTER(main, LOG_LEVEL_DBG);

#define LED0	"GPIO_0"
#define PIN	5

const struct device *led_dev;

void assert_post_action(const char *file, unsigned int line)
{
	if (gpio_pin_set_raw(led_dev, PIN, 0)) {
		return;
	}

	static struct k_spinlock lock;

	k_spinlock_key_t key = k_spin_lock(&lock);
	while(1){
	}
	k_spin_unlock(&lock, key);
}

static void sleep_and_reboot(void)
{
	k_sleep(K_MSEC(2));
	sys_reboot(SYS_REBOOT_WARM);
}

void main(void)
{
	led_dev = device_get_binding(LED0);
	if (gpio_pin_configure(led_dev, PIN, GPIO_OUTPUT)) {
		return;
	}

	if (gpio_pin_set_raw(led_dev, PIN, 1)) {
		return;
	}

	if (usb_enable(NULL)) {
		return;
	}

	sleep_and_reboot();
}
```
